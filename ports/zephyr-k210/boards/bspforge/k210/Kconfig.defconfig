## ports/zephyr-k210/boards/bspforge/k210/Kconfig.defconfig
```kconfig
if BOARD_K210

config SYS_CLOCK_TICKS_PER_SEC
	default 1000

config SYS_CLOCK_HW_CYCLES_PER_SEC
	default 7800000

config NUM_IRQS
	default 66

endif
```

## ports/zephyr-k210/boards/bspforge/k210/board.yml
```yaml
board:
  name: k210
  full_name: Kendryte K210 SDK-derived board
  vendor: bspforge
  socs:
    - name: kendryte_k210
```

## ports/zephyr-k210/soc/bspforge/k210/Kconfig
```kconfig
config SOC_KENDRYTE_K210
	select INCLUDE_RESET_VECTOR
	select RISCV
	select RISCV_PRIVILEGED
	select RISCV_SOC_HAS_GP_RELATIVE_ADDRESSING
	select RISCV_HAS_PLIC
```

## ports/zephyr-k210/soc/bspforge/k210/Kconfig.defconfig
```kconfig
if SOC_KENDRYTE_K210

config RISCV_ISA_EXT_D
	default y

config RISCV_ISA_EXT_F
	default y

config RISCV_SOC_INTERRUPT_INIT
	default y

config 2ND_LVL_ISR_TBL_OFFSET
	default 12

config 2ND_LVL_INTR_00_OFFSET
	default 11

config MAX_IRQ_PER_AGGREGATOR
	default 66

configdefault NUM_IRQS
	default 78

endif
```

## ports/zephyr-k210/soc/bspforge/k210/Kconfig.soc
```kconfig
config SOC_KENDRYTE_K210
	bool
	help
	  Kendryte K210 RV64 SoC recovered from the standalone SDK platform assets.

config SOC
	default "kendryte_k210" if SOC_KENDRYTE_K210
```
